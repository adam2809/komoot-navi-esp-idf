## components/anti_theft_esp32/Kconfig
```kconfig
menu "Anti theft system configuration"
    config MPU6050_INTERRUPT_INPUT_PIN
        int "Set MPU6050 interrupt pin"
        default 13
        help
            Set pin that will be used as an interrupt pin for getting wake signal from the imu
    config BUZZER_PIN
        int "Set buzzer pin"
        default 32
        help
            Set pin that will be connected to transistor base which controls buzzer
endmenu
```
